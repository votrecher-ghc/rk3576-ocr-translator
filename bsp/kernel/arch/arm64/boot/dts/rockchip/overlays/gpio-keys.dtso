// SPDX-License-Identifier: GPL-2.0
/*
 * gpio-keys.dtso - OCR系统GPIO按键DTS Overlay
 *
 * 描述: 鲁班猫3 40Pin上的GPIO按键，用于触发OCR拍照。
 *       GPIO0 PC0 (Pin对应鲁班猫3 40Pin表)
 *       按键码: KEY_CAMERA (0xd8)
 *       消抖间隔: 20ms
 *
 * 作者: OCR Team <ocr@example.com>
 * 许可证: GPL-2.0
 */

/dts-v1/;
/plugin/;

#include <dt-bindings/gpio/gpio.h>
#include <dt-bindings/pinctrl/rockchip.h>
#include <dt-bindings/input/input.h>

/ {
	compatible = "rockchip,rk3576";

	fragment@0 {
		target = <&gpio0>;

		__overlay__ {
			/*
			 * GPIO按键配置
			 * GPIO0 PC0 -> 鲁班猫3 40Pin对应引脚
			 * 低电平有效(按下接地), 内部上拉
			 */
			ocr_gpio_keys: ocr-gpio-keys {
				compatible = "ocr,gpio-keys";
				label = "ocr-camera-key";

				/* GPIO0 PC0, 低电平有效 */
				gpios = <&gpio0 16 GPIO_ACTIVE_LOW>;

				/* 按键码: KEY_CAMERA = 0xd8 */
				linux,code = <KEY_CAMERA>;

				/* 消抖间隔: 20ms */
				debounce-interval = <20>;

				status = "okay";
			};
		};
	};
};
