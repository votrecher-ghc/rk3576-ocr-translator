// SPDX-License-Identifier: GPL-2.0
/*
 * icm42688-spi.dtso - ICM42688六轴IMU SPI DTS Overlay
 *
 * 描述: ICM42688挂载在SPI0总线上，使用CS0片选。
 *       SPI最大频率: 24MHz
 *       中断引脚: GPIO0 PB2
 *
 * 作者: OCR Team <ocr@example.com>
 * 许可证: GPL-2.0
 */

/dts-v1/;
/plugin/;

#include <dt-bindings/gpio/gpio.h>
#include <dt-bindings/pinctrl/rockchip.h>
#include <dt-bindings/interrupt-controller/irq.h>

/ {
	compatible = "rockchip,rk3576";

	fragment@0 {
		target = <&spi0>;

		__overlay__ {
			status = "okay";

			/* ICM42688六轴IMU, CS0 */
			icm42688: icm42688@0 {
				compatible = "ocr,icm42688";
				reg = <0>;

				/* SPI配置 */
				spi-max-frequency = <24000000>;
				spi-cpha;
				spi-cpol;

				/* 中断引脚: GPIO0 PB2, 低电平有效 */
				interrupt-parent = <&gpio0>;
				interrupts = <10 IRQ_TYPE_EDGE_FALLING>;

				/* 供电配置 */
				vdd-supply = <&vcc_3v3_s3>;
				vddio-supply = <&vcc_1v8_s3>;

				status = "okay";
			};
		};
	};
};
