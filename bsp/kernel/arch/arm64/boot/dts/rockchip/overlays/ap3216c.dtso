// SPDX-License-Identifier: GPL-2.0
/*
 * ap3216c.dtso - AP3216C环境光/接近传感器DTS Overlay
 *
 * 描述: AP3216C挂载在i2c4总线上，地址0x1E。
 *       中断引脚: GPIO0 PA1
 *
 * 作者: OCR Team <ocr@example.com>
 * 许可证: GPL-2.0
 */

/dts-v1/;
/plugin/;

#include <dt-bindings/gpio/gpio.h>
#include <dt-bindings/pinctrl/rockchip.h>
#include <dt-bindings/interrupt-controller/irq.h>

/ {
	compatible = "rockchip,rk3576";

	fragment@0 {
		target = <&i2c4>;

		__overlay__ {
			status = "okay";

			/* AP3216C环境光/接近传感器 */
			ap3216c: ap3216c@1e {
				compatible = "ocr,ap3216c";
				reg = <0x1e>;

				/* 中断引脚: GPIO0 PA1, 低电平有效 */
				interrupt-parent = <&gpio0>;
				interrupts = <1 IRQ_TYPE_EDGE_FALLING>;

				/* 供电配置（如果需要） */
				vdd-supply = <&vcc_3v3_s3>;
				vled-supply = <&vcc_3v3_s3>;

				status = "okay";
			};
		};
	};
};
