// SPDX-License-Identifier: GPL-2.0
/*
 * pwm-fan.dtso - 用户态 PWM 风扇 DTS Overlay
 *
 * 描述: 只启用 pwm11 控制器。ocr_translator 通过 PWM sysfs export、
 *       period/duty_cycle/enable 完成四档调速。这里不能再创建
 *       ocr,pwm-fan consumer，否则内核会独占同一 PWM，用户态无法控制。
 *
 * 作者: OCR Team <ocr@example.com>
 * 许可证: GPL-2.0
 */

/dts-v1/;
/plugin/;

#include <dt-bindings/gpio/gpio.h>
#include <dt-bindings/pinctrl/rockchip.h>

/ {
	compatible = "rockchip,rk3576";

	fragment@0 {
		target = <&pwm11>;

		__overlay__ {
			/* Userspace discovers the dynamically numbered pwmchip by this marker. */
			ocr,fan-pwm;
			status = "okay";
		};
	};

};
