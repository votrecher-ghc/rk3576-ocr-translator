// SPDX-License-Identifier: GPL-2.0
/*
 * adt7410.dtso - ADT7410温度传感器DTS Overlay
 *
 * 描述: ADT7410挂载在i2c4总线上（与AP3216C共用），地址0x48。
 *       用于OCR系统温度监测，同时为PWM风扇驱动提供温度数据。
 *
 * 作者: OCR Team <ocr@example.com>
 * 许可证: GPL-2.0
 */

/dts-v1/;
/plugin/;

#include <dt-bindings/gpio/gpio.h>
#include <dt-bindings/pinctrl/rockchip.h>
#include <dt-bindings/interrupt-controller/irq.h>

/ {
	compatible = "rockchip,rk3576";

	fragment@0 {
		target = <&i2c4>;

		__overlay__ {
			status = "okay";

			/* ADT7410温度传感器, 地址0x48 */
			adt7410: adt7410@48 {
				compatible = "ocr,adt7410";
				reg = <0x48>;

				/* 供电配置 */
				vdd-supply = <&vcc_3v3_s3>;

				status = "okay";
			};

			/* 定义IIO通道，供PWM风扇驱动引用 */
			adt7410_iio: adt7410-iio {
				/* IIO通道名称，pwm_fan通过此名称获取温度 */
				io-channels = <&adt7410 0>;
				io-channel-names = "temp_adc";
			};
		};
	};
};
