## bsp/buildroot/configs/ocr_translator_defconfig
```kconfig
# =====================================================================
# Buildroot defconfig - OCR 翻译设备 (野火 LubanCat3 / RK3576)
# 功能: 为 OCR 翻译设备定制最小化 rootfs
# 裁剪: 去除 Python, GUI 框架, 多余网络服务
# =====================================================================

# ---------------------- 目标架构 ----------------------
BR2_aarch64=y
BR2_cortex_a72=y

# ---------------------- 工具链: 外部 Linaro aarch64 ----------------------
BR2_TOOLCHAIN_EXTERNAL=y
BR2_TOOLCHAIN_EXTERNAL_LINARO_AARCH64=y
BR2_TOOLCHAIN_EXTERNAL_CXX=y

# ---------------------- 编译选项 ----------------------
BR2_OPTIMIZE_2=y
BR2_SSP_STRONG=y
BR2_RELRO_FULL=y
BR2_FORTIFY_SOURCE_2=y

# ---------------------- 系统配置 ----------------------
BR2_TARGET_GENERIC_HOSTNAME="ocr-translator"
BR2_TARGET_GENERIC_ISSUE="OCR Translator (LubanCat3 RK3576)"
BR2_INIT_SYSV=y
BR2_ROOTFS_DEVICE_CREATION_DYNAMIC_EUDEV=y
BR2_ROOTFS_MERGED_USR=y

# 禁用不需要的服务
# BR2_PACKAGE_BUSYBOX_SHOW_OTHERS is not set

# ---------------------- Linux 内核 (使用预编译镜像, 不在 Buildroot 构建) ----------------------
# BR2_LINUX_KERNEL is not set

# ---------------------- 文件系统 ----------------------
BR2_TARGET_ROOTFS_EXT2=y
BR2_TARGET_ROOTFS_EXT2_4=y
BR2_TARGET_ROOTFS_EXT2_SIZE="512M"
BR2_TARGET_ROOTFS_EXT2_LABEL="rootfs"
BR2_TARGET_ROOTFS_EXT2_MKFS_OPTIONS="-O ^64bit"

# ---------------------- Rootfs overlay (自定义文件) ----------------------
BR2_ROOTFS_OVERLAY="$(BR2_EXTERNAL_OCR_PATH)/board/rockchip/rk3576-lubancat3/rootfs_overlay"

# ---------------------- Post-build 脚本 (拷贝 RKNN 运行时等) ----------------------
BR2_ROOTFS_POST_BUILD_SCRIPT="$(BR2_EXTERNAL_OCR_PATH)/board/rockchip/rk3576-lubancat3/post_build.sh"

# ---------------------- 包: 核心库 ----------------------

# DRM / 显示
BR2_PACKAGE_LIBDRM=y
BR2_PACKAGE_LIBDRM_INSTALL_TESTS=y

# RGA (Rockchip 2D 图形加速)
BR2_PACKAGE_LIBRGA=y

# RKNN 运行时 (NPU 推理)
BR2_PACKAGE_RKNN_RUNTIME=y

# FreeType (字体渲染)
BR2_PACKAGE_FREETYPE=y

# cJSON (JSON 配置解析)
BR2_PACKAGE_CJSON=y

# jpeg-turbo (JPEG 归档；Buildroot 的包符号不带 LIB 前缀)
BR2_PACKAGE_JPEG=y
BR2_PACKAGE_JPEG_TURBO=y
BR2_PACKAGE_JPEG_SIMD_SUPPORT=y

# pthread 由目标工具链的 libc 提供，不需要额外启用 PAM。

# libpng (字体/图标资源)
BR2_PACKAGE_LIBPNG=y

# zlib (压缩)
BR2_PACKAGE_ZLIB=y

# IIO 传感器调试工具 (iio_info/iio_readdev)
BR2_PACKAGE_LIBIIO=y
BR2_PACKAGE_LIBIIO_LOCAL_BACKEND=y
BR2_PACKAGE_LIBIIO_TESTS=y

# ---------------------- 包: 网络与调试 (最小化) ----------------------
# Lightweight SSH server for board bring-up.
BR2_PACKAGE_DROPBEAR=y
# Network configuration tools.
BR2_PACKAGE_IPROUTE2=y
BR2_PACKAGE_ETHTOOL=y

# ---------------------- 包: 系统工具 ----------------------
# Device manager.
BR2_PACKAGE_EUDEV=y
BR2_PACKAGE_UTIL_LINUX=y
BR2_PACKAGE_UTIL_LINUX_MOUNT=y
BR2_PACKAGE_UTIL_LINUX_SCHEDUTILS=y

# V4L2 工具 (调试摄像头用)
BR2_PACKAGE_V4L2_TOOLS=y

# ---------------------- 裁剪: 移除不需要的组件 ----------------------
# BR2_PACKAGE_PYTHON is not set
# BR2_PACKAGE_PYTHON3 is not set
# BR2_PACKAGE_QT5 is not set
# BR2_PACKAGE_GTK3 is not set
# BR2_PACKAGE_XORG7 is not set
# BR2_PACKAGE_WAYLAND is not set
# BR2_PACKAGE_WESTON is not set

# 禁用多余网络服务
# BR2_PACKAGE_SAMBA is not set
# BR2_PACKAGE_NFS_UTILS is not set
# BR2_PACKAGE_AVAHI is not set
# BR2_PACKAGE_HTTPD is not set
```
