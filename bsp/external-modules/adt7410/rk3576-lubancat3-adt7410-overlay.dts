/*
 * 板级温度传感器连接描述，声明 ADT7410 的 I2C 地址及 IIO 通道提供者。
 * 节点绑定到 iio_adt7410 驱动，温度通道可被内核风扇控制器引用。
 */
/dts-v1/;
/plugin/;

/ {
	compatible = "embedfire,rk3576-lubancat-3", "rockchip,rk3576";
};

&i2c7 {
	status = "okay";
	clock-frequency = <400000>;
	pinctrl-names = "default";
	pinctrl-0 = <&i2c7m1_xfer>;

	adt7410: adt7410@48 {
		compatible = "adi,adt7410";
		reg = <0x48>;
		#io-channel-cells = <1>;
		status = "okay";
	};
};
