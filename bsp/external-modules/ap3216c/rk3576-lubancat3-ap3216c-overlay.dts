/*
 * 板级光学传感器连接描述，声明 AP3216C 的 I2C 地址、总线速度及引脚配置。
 * 驱动注册 IIO 通道，应用按 IIO name 自动发现设备，无需依赖固定编号。
 */
/dts-v1/;
/plugin/;

/ {
	compatible = "embedfire,rk3576-lubancat-3", "rockchip,rk3576";
};

&i2c7 {
	status = "okay";
	clock-frequency = <400000>;
	pinctrl-names = "default";
	pinctrl-0 = <&i2c7m1_xfer>;

	ap3216c@1e {
		compatible = "liteon,ap3216c";
		reg = <0x1e>;
		status = "okay";
	};
};
